## arch/arm/mach-msm/htc/Kconfig
```kconfig
menu "HTC Board Selection"
config MACH_HTC
	default n
	bool "HTC board"
source "arch/arm/mach-msm/htc/Kconfig.board"
endmenu

menu "HTC Specific Patches"

config PERFLOCK
        depends on CPU_FREQ
        depends on ARCH_MSM8960 || ARCH_MSM8X60 || ARCH_QSD8X50 || ARCH_MSM7X30 || ARCH_MSM7X00A || ARCH_MSM7X27A || ARCH_MSM7X25
        default n
        bool "HTC Performance Lock"

config PERFLOCK_BOOT_LOCK
        depends on PERFLOCK
        depends on ARCH_MSM8960 || ARCH_MSM8X60 || ARCH_QSD8X50 || ARCH_MSM7X30 || ARCH_MSM7X00A || ARCH_MSM7X27A || ARCH_MSM7X25
        default n
        bool "Boot Time Performance Lock"

config PERFLOCK_SCREEN_POLICY
        depends on PERFLOCK
        depends on ARCH_MSM8960 || ARCH_MSM8X60 || ARCH_QSD8X50 || ARCH_MSM7X00A || ARCH_MSM7X27A || ARCH_MSM7X25
        default n
        bool "Change Cpufreq Policy while Screen ON/OFF"

config PERFLOCK_SCREEN_ON_MIN
        depends on PERFLOCK_SCREEN_POLICY
        int "Minimum speed while screen on"
        default 245760

config PERFLOCK_SCREEN_ON_MAX
        depends on PERFLOCK_SCREEN_POLICY
        int "Maximum speed while screen on"
        default 768000

config PERFLOCK_SCREEN_OFF_MIN
        depends on PERFLOCK_SCREEN_POLICY
        int "Minimum speed while screen off"
        default 245760

config PERFLOCK_SCREEN_OFF_MAX
        depends on PERFLOCK_SCREEN_POLICY
        int "Maximum speed while screen off"
        default 245760

config HTC_BATTCHG
        depends on MSM_ONCRPCROUTER && POWER_SUPPLY
        default n
        bool "HTC battery / charger driver"

config HTC_BATTCHG_SMEM
        depends on (HTC_BATTCHG || HTC_BATTCHG_MAX8957)
        default n
        bool "Read Battery Info via SMEM"

config HTC_HEADSET_MGR
	tristate "HTC headset manager driver"
	default n
	help
	  Provides support of HTC headset manager.

config HTC_HEADSET_GPIO
	tristate "HTC GPIO headset detection driver"
	depends on HTC_HEADSET_MGR
	default n
	help
	  Provides support of HTC GPIO headset detection.

config HTC_HEADSET_MICROP
	tristate "HTC Micro-P headset detection driver"
	depends on HTC_HEADSET_MGR && MICROP_COMMON
	default n
	help
	  Provides support of HTC Micro-P headset detection.

config HTC_HEADSET_PMIC
	tristate "HTC PMIC headset detection driver"
	depends on HTC_HEADSET_MGR
	default n
	help
	  Provides support of HTC PMIC headset detection.

config HTC_HEADSET_MISC
	tristate "HTC MISC headset detection driver"
	depends on HTC_HEADSET_MGR
	default n
	help
	  Provides support of HTC MISC headset detection.

config CABLE_DETECT_8X55
        boolean "Cable detect driver"
        default n
        help
          Detect usb, ac and other accessories.

config CABLE_DETECT_ACCESSORY
        boolean "CABLE ACCESSORY DETECT"
        default n

config CABLE_DETECT_ACCESSORY_BY_ADC
        boolean "DETECT ACCESSORY BY PMIC ADC"
        default n

config USB_ACCESSORY_DETECT_BY_ADC
        boolean "DETECT USB ACCESSORY BY PMIC ADC"
        default n

config MICROP_COMMON
	tristate "MICROP COMMON Driver"
	depends on I2C
	help
	  HTC Microp-P support.

config REMOVE_EBI1_FIXED_CLK
	bool "remove ebi1 fixed clk"
	default n
	help
		use for 2x Radio

config WIFI_NVS_PROC_CREATE
	bool "Store nvs data into /proc/calibration"
	help
	  store nvs data into /proc/calibration

config ARCH_MSM7X30_SMD
       bool "Support QCT 7X30 SMD function"
       default n
       help
         For QCT SMD function, we need 7x30 rpcrouter and smd drivers.

config MSM_SMD0_WQ
	bool "SMD0 TTY Workqueue"
	depends on (MSM_SMD)
	default y
	help
	Independent tty workqueue for SMD0

config SMD_OFFSET_TCXO_STAT
	depends on MSM_SMD
	hex "SMD offset of total TCXO-off time"
	default 0x0
	help
          TCXO off time is in tick of sleep clock, 1/32768.

config SMD_OFFSET_NEGATE_CLIENT_STAT
        depends on MSM_SMD
	hex "SMD offset of negate clinet stat"
        default 0x0
        help
          TCXO shutdown retry conuter and negate tcxoc client counters.

if !FB_MSM_NEW
config MSM_MDP40
	bool
	depends on ARCH_MSM7X30 || ARCH_MSM8X60
	default y
endif

endmenu
```

## arch/arm/mach-msm/htc/Kconfig.board
```kconfig
#
# Include the specific Kconfig file for HTC board
#

# FLYER
source "arch/arm/mach-msm/htc/flyer/Kconfig"

config MACH_HTC_DUMMY
       depends on MACH_HTC
       bool "NONE (No device)"
```

## arch/arm/mach-msm/htc/Kconfig.offsets
```kconfig
config PHYS_OFFSET
	hex
    default "0x14400000" if ARCH_MSM7X30 && MACH_FLYER
	default "0x10000000"
```

## arch/arm/mach-msm/htc/flyer/Kconfig
```kconfig
config BOARD_HEADER_FILE
	string "HTC board specific header file name"
	default ""

config MACH_FLYER
       depends on ARCH_MSM7X30
       default n
       bool "MSM7x30 FLYER"
	   select MACH_HTC
       select MSM7X30_DDR2
       select TIMING_PCLK_53M
       help
         Support for the Qualcomm MSM7x30 Flyer board.
```

## drivers/i2c/chips/Kconfig
```kconfig
#
# Miscellaneous I2C chip drivers configuration
#
# *** DEPRECATED! Do not add new entries! See Makefile ***
#

menu "Miscellaneous I2C Chip support"

config SENSORS_AKM8975
        tristate "AKM8973 Compass Driver"
        depends on I2C
        help
         AKM8975 Compass Driver implemented by HTC.

config SENSORS_BMA150
	tristate "BMA150 G-sensor Driver"
	depends on I2C
	help
	 BMA150 G-sensor Driver implemented by HTC.

config SENSORS_CAPSENSE
	tristate "CapSense Driver"
	depends on I2C
	help
	 CapSense Driver implemented by HTC.

config TPS65200
        tristate "tps65200 Driver"
        depends on I2C
        help
         TPS65200 Switch charger implemented by HTC.
         This could enable battery driver to set
         Charging current 100mA~500mA or 500mA~1000mA
         by GPIO or Register

	  PANASONIC GYR Driver implemented by HTC.

endmenu
```
